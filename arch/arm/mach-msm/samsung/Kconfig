## arch/arm/mach-msm/samsung/Kconfig
```kconfig
config MACH_SAMSUNG
	bool

menu "SAMSUNG Board Selection"
source "arch/arm/mach-msm/samsung/Kconfig.board"
endmenu

menu "SAMSUNG Specific Patches"

choice
	prompt "Target Locale"
	default TARGET_LOCALE_USA

	config TARGET_LOCALE_KOR
		bool "Locale KOR "
		help
		  Support Korea SKT Board

	config TARGET_LOCALE_USA
		bool "Locale USA "
		help
		  Support USA Board

	config TARGET_LOCALE_JPN
		bool "Locale JPN "
		help
		  Support JPN Board

	config TARGET_LOCALE_EUR
		bool "Locale EUR "
		help
		  Support EUR Board
endchoice

config BATTERY_SEC
	bool "SEC battery driver"
	default n
	help
	  Say Y here to enable support for batteries with SEC features.

config SEC_AUDIO_DEVICE
	bool "Sec AUDIO DEVICE"
	help
	  Support Sec audio Device

config SEC_AUDIO_I2S_DRIVING_CURRENT
	bool "Sec I2S Driving Current"
	default n
	help
	  Support I2S driving current up

config SEC_EXTRA_VOLUME_SOL
	bool "Sec Extra Volume Solution"
	default n
	help
	  Support Sec Extra Volume Solution

endmenu
```

## arch/arm/mach-msm/samsung/Kconfig.board
```kconfig
#
# Include the specific Kconfig file for SAMSUNG board
#

# CELOX
source "arch/arm/mach-msm/samsung/celox/Kconfig"
```

## arch/arm/mach-msm/samsung/celox/Kconfig
```kconfig
config BOARD_HEADER_FILE
	string "SAMSUNG board specific header file name"
	default ""

config MACH_CELOX
	depends on ARCH_MSM8X60
	select MACH_SAMSUNG
        select REMOVE_SMI_2X_CLK
        select MSM_SDIO_AL
	bool "Samsung Celox"
	help
	  Support for the Samsung Celox family.

choice
	prompt "Celox Model"
	depends on MACH_CELOX

	config USA_MODEL_SGH_I727
		select TARGET_LOCALE_USA
		bool "USA ATT SGH-I727"

	config USA_MODEL_SGH_I727R
		depends on USA_MODEL_SGH_I727
		bool "USA ATT SGH-I727R"

	config EUR_MODEL_GT_I9210
		depends on USA_MODEL_SGH_I727
		bool "EUR OPEN GT-I9210"

	config USA_MODEL_SGH_T989
		select TARGET_LOCALE_USA
		bool "USA ATT SGH-T989"

	config USA_MODEL_SGH_T769
		select TARGET_LOCALE_USA
		bool "USA TMO SGH-T769"

	config USA_MODEL_SGH_I577
		select TARGET_LOCALE_USA
		bool "USA ATT SGH-I577"

endchoice
```

## drivers/net/wireless/bcmdhd_sec/Kconfig
```kconfig
config BROADCOM_WIFI
	bool "Broadcom WiFi Driver"
	depends on WLAN
	default y if MACH_SAMSUNG
	---help---
		This is a configuration for broadcom WLAN driver.

config BCM4330
	tristate "Broadcom 4330 wireless cards support"
	depends on BROADCOM_WIFI
	---help---
	  This module adds support for wireless adapters based on
	  Broadcom 4330 chipset.

config BCM4334
	tristate "Broadcom 4334 wireless cards support"
	depends on BROADCOM_WIFI
	---help---
	  This module adds support for wireless adapters based on
	  Broadcom 4334 chipset.

config BCM4335
	tristate "Broadcom 4335 wireless cards support"
	depends on BROADCOM_WIFI
	---help---
	  This module adds support for wireless adapters based on
	  Broadcom 4335 chipset.

config BCM4339
	tristate "Broadcom 4339 wireless cards support"
	depends on BROADCOM_WIFI
	---help---
	  This module adds support for wireless adapters based on
	  Broadcom 4339 chipset.

config BCM43241
	tristate "Broadcom 43241 wireless cards support"
	depends on BROADCOM_WIFI
	---help---
	  This module adds support for wireless adapters based on
	  Broadcom 43241 chipset.

config BCMDHD_FW_PATH
	depends on BROADCOM_WIFI
	string "Firmware path"
	default "/system/etc/firmware/fw_bcmdhd.bin"
	---help---
	  Path to the firmware file.

config BCMDHD_NVRAM_PATH
	depends on BROADCOM_WIFI
	string "NVRAM path"
	default "/system/etc/wifi/bcmdhd.cal"
	---help---
	  Path to the calibration file.

config BROADCOM_WIFI_RESERVED_MEM
	bool "BROADCOM Reserved memory for wifi device"
	depends on (BCM4330 || BCM4334 || BCM4335 || BCM4339 || BCM43241)
	---help---
	  This is a configuration for broadcom WLAN driver.

config BCM4335BT
	bool "BROADCOM BTLOCK Enable"
	depends on BCM4335
	default y
	---help---
	  This is a configuration for bt lock enable.

config WIFI_BROADCOM_COB
	bool "BROADCOM COB type chip is enabled"
	depends on (BCM4330 || BCM4334 || BCM4335 || BCM4339 || BCM43241)
	---help---
	  This is a configuration for COB type feature.

config WLAN_REGION_CODE
	int "---Region codes for Broadcom WiFi Driver"
	depends on (BCM4330 || BCM4334 || BCM4335 || BCM4339 || BCM43241)
	default 100
	---help---
		This is a region code for Broadcom Wi-Fi featured functions.
		- 100 : EUR OPEN
		- 101 : EUR ORG
		- 200 : KOR OPEN
		- 201 : KOR SKT
		- 202 : KOR KTT
		- 203 : KOR LGT
		- 300 : CHN OPEN
		- 400 : USA OPEN
		- 401 : USA ATT
		- 402 : USA TMO
		- 403 : USA VZW
		- 404 : USA SPR
		- 405 : USA USC

config WIFI_2GHZ_VHT_NO_SUPPORT
	bool "BROADCOM Reserved memory for wifi device"
	depends on BCM4339
	default n
	---help---
	  This is a configuration for 2GHZ VHT mode.

config WLAIBSS
	bool "Advanced IBSS mode"
	depends on (BCM4335 || BCM4339)
	default y
	---help---
	  This is a configuration for Oxygen Network.
```
